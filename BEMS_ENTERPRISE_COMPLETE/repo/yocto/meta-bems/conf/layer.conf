## BEMS_ENTERPRISE_COMPLETE/repo/yocto/meta-bems/conf/layer.conf
```bitbake
BBPATH .= ":${LAYERDIR}"
BBFILES += "${LAYERDIR}/recipes-*/*/*.bb"

BBFILE_COLLECTIONS += "bems"
BBFILE_PATTERN_bems = "^${LAYERDIR}/"
BBFILE_PRIORITY_bems = "6"

LAYERSERIES_COMPAT_bems = "nanbield scarthgap styhead"
```

## BEMS_ENTERPRISE_COMPLETE/repo/yocto/meta-bems/conf/machine/edge-core.conf
```bitbake
#@TYPE: Machine
#@NAME: BEMS Edge Core
#@DESCRIPTION: Generic ARM64 edge-core machine profile for the IntelliBuild BEMS BACnet/RabbitMQ edge runtime.

MACHINEOVERRIDES =. "edge-core:"

DEFAULTTUNE ?= "cortexa55-crypto"
require conf/machine/include/arm/armv8a/tune-cortexa55.inc

PREFERRED_PROVIDER_virtual/kernel ?= "linux-yocto"
KERNEL_IMAGETYPE ?= "Image"

SERIAL_CONSOLES ?= "115200;ttymxc0 115200;ttyS0"
MACHINE_FEATURES = "acpi alsa bluetooth efi ethernet ext4 pci rtc serial usbhost wifi"
MACHINE_EXTRA_RRECOMMENDS += "kernel-modules"

IMAGE_FSTYPES += "wic.gz tar.bz2"
WKS_FILE ?= "directdisk.wks"

QB_SYSTEM_NAME ?= "qemu-system-aarch64"
QB_MACHINE ?= "-machine virt"
QB_CPU ?= "-cpu cortex-a55"
QB_MEM ?= "-m 1024"
QB_DEFAULT_KERNEL ?= "none"
```
